## main/Kconfig
```kconfig
menu "ESP32-Fruitland Configuration"

    config FRUITLAND_USB_KEYBOARD_SUPPORT
        bool "Enable USB HID Keyboard Support"
        default y if IDF_TARGET_ESP32P4
        default n
        help
            Enable USB HID keyboard support for game input.
            This requires USB host capabilities and is automatically
            enabled for ESP32-P4 which has built-in USB host support.
            
            This feature allows connecting USB keyboards directly to
            the ESP32 board for game control input.

    config FRUITLAND_ACCELEROMETER_INPUT
        bool "Enable Accelerometer Input Support"
        default y if SDL_BSP_ESP_BOX_3
        default n
        help
            Enable accelerometer-based motion control for game input.
            This uses the onboard ICM42670 6-axis accelerometer to detect
            device tilt and translate it to directional movement commands.
            
            Automatically enabled for ESP32-S3-BOX-3 which has the
            ICM42670 accelerometer sensor built-in.
            
            This feature allows playing the game by tilting the device
            in the desired movement direction.

endmenu
```

## sdkconfig.defaults.esp32_p4_function_ev_board
```kconfig
# ESP32-P4 Function EV Board Configuration Defaults
# Optimized for high-performance 2D gaming inspired by Quake implementation

# Board selection
CONFIG_SDL_BSP_ESP32_P4_FUNCTION_EV=y
# Disable touch support to avoid complex initialization issues
CONFIG_SDL_BSP_TOUCH_ENABLE=n

CONFIG_IDF_TARGET="esp32p4"
CONFIG_ESPTOOLPY_FLASHSIZE_16MB=y
CONFIG_ESPTOOLPY_FLASHMODE_QIO=y

# Compiler optimizations for maximum performance
CONFIG_COMPILER_OPTIMIZATION_PERF=y
CONFIG_COMPILER_OPTIMIZATION_ASSERTIONS_DISABLE=y
# CONFIG_COMPILER_OPTIMIZATION_CHECKS_SILENT=y
CONFIG_FREERTOS_HZ=1000

# PSRAM Configuration for ESP32-P4 - optimized for gaming performance
CONFIG_SPIRAM=y
CONFIG_SPIRAM_MODE_HEX=y
CONFIG_SPIRAM_SPEED_200M=y
CONFIG_SPIRAM_XIP_FROM_PSRAM=y
CONFIG_SPIRAM_FETCH_INSTRUCTIONS=y
CONFIG_SPIRAM_RODATA=y
CONFIG_SPIRAM_ALLOW_BSS_SEG_EXTERNAL_MEMORY=y
CONFIG_SPIRAM_ALLOW_NOINIT_SEG_EXTERNAL_MEMORY=y
# CONFIG_SPIRAM_MEMTEST is not set

# Cache optimizations for ESP32-P4
CONFIG_CACHE_L2_CACHE_256KB=y
CONFIG_CACHE_L2_CACHE_LINE_128B=y

# ESP32-P4 specific features and hardware acceleration
CONFIG_IDF_EXPERIMENTAL_FEATURES=y

# Display and BSP optimizations
CONFIG_BSP_LCD_DPI_BUFFER_NUMS=2
# CONFIG_BSP_ERROR_CHECK is not set

# Task and memory optimizations
CONFIG_ESP_MAIN_TASK_STACK_SIZE=32000
# CONFIG_ESP_TASK_WDT_EN is not set  # Disable watchdog for performance

# Panic behavior - optimized for development
CONFIG_ESP_SYSTEM_PANIC_GDBSTUB=y
CONFIG_ESP_PANIC_HANDLER_IRAM=y
CONFIG_ESP_CONSOLE_SECONDARY_NONE=y

# ESP32-P4-LCD-Ev-Kit resolution 1024x600
CONFIG_BSP_LCD_TYPE_1024_600=y

# File system optimizations
CONFIG_FATFS_LFN_STACK=y

# Custom partition table for assets
CONFIG_PARTITION_TABLE_CUSTOM=y
CONFIG_PARTITION_TABLE_CUSTOM_FILENAME="partitions_esp32p4_16mb.csv"
```
